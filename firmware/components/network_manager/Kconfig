## firmware/components/network_manager/Kconfig
```kconfig
menu "ESP-BMC: NetworkManager (WLAN)"

    config ESP_BMC_WIFI_SSID
        string "WLAN-SSID (Platzhalter, siehe Pflichtenheft 3.4)"
        default "CHANGE_ME_SSID"
        help
            Noch keine LittleFS-Konfigurationsablage (ConfigManager persistiert
            noch nicht, siehe Pflichtenheft Abschnitt 12). Bis dahin wird die
            SSID hier als Platzhalter ueber Kconfig/sdkconfig gepflegt.

    config ESP_BMC_WIFI_PASSWORD
        string "WLAN-Passwort (Platzhalter)"
        default "CHANGE_ME_PASSWORD"

endmenu
```

## firmware/components/sensor_manager/Kconfig
```kconfig
menu "ESP-BMC: SensorManager (NTC + DHT11)"

    config ESP_BMC_SENSOR_DHT_IS_DHT22_FORMAT
        bool "DHT-Sensor liefert DHT22-Datenformat (0.1-Aufloesung) statt DHT11"
        default n
        help
            Reale Hardware ist ein DHT11 (docs/bom.md, Ganzzahlformat).
            Wokwis Simulator stellt keinen eigenen DHT11-Part bereit, nur
            "wokwi-dht22" - dessen Protokoll ist bit-/pruefsummenkompatibel,
            nutzt aber das DHT22-Datenformat (0.1-Aufloesung, Vorzeichenbit).
            Diese Option wird deshalb ausschliesslich in
            sdkconfig.wokwi-sim auf "y" gesetzt (siehe docs/entscheidungen.md,
            Eintrag P3 Sensorik), die reale Hardware-Env bleibt auf "n".

endmenu
```

## firmware/components/wireguard_manager/Kconfig
```kconfig
menu "ESP-BMC: WireGuardManager (P1 Machbarkeits-Spike)"

    config ESP_BMC_WG_ENABLE
        bool "WireGuard-Tunnel beim Start aufbauen"
        default n
        help
            Standardmaessig aus, da die Platzhalter-Konfiguration unten nicht
            auf einen echten Peer zeigt. Erst aktivieren, wenn eine echte
            WireGuard-Konfiguration eingetragen wurde (siehe Pflichtenheft
            Abschnitt 4.1 - Ablage spaeter ueber LittleFS/Webinterface-Upload,
            hier vorerst nur Kconfig-Platzhalter fuer den Machbarkeits-Spike).

    config ESP_BMC_WG_PRIVATE_KEY
        string "Eigener privater Schluessel (Base64)"
        default "AAAAAAAAAAAAAAAAAAAAAAAAAAAAAAAAAAAAAAAAAAA="
        help
            Platzhalter (32 Null-Bytes, syntaktisch gueltiges Base64) - KEIN
            echter Schluessel. Vor einem echten Verbindungsversuch ersetzen.

    config ESP_BMC_WG_LOCAL_IP
        string "Eigene Tunnel-IP"
        default "10.0.0.2"

    config ESP_BMC_WG_LOCAL_IP_NETMASK
        string "Tunnel-Netzmaske"
        default "255.255.255.0"

    config ESP_BMC_WG_LOCAL_PORT
        int "Lokaler WireGuard-UDP-Port"
        default 51820

    config ESP_BMC_WG_PEER_PUBLIC_KEY
        string "Oeffentlicher Schluessel des Peers (Base64)"
        default "AAAAAAAAAAAAAAAAAAAAAAAAAAAAAAAAAAAAAAAAAAA="
        help
            Platzhalter, siehe ESP_BMC_WG_PRIVATE_KEY.

    config ESP_BMC_WG_PEER_ENDPOINT
        string "Adresse/Hostname des Peers"
        default "CHANGE_ME.example.invalid"

    config ESP_BMC_WG_PEER_PORT
        int "UDP-Port des Peers"
        default 51820

endmenu
```

## firmware/sdkconfig.defaults
```kconfig
# ESP-BMC - sdkconfig-Defaults
# Aktiviert PSRAM (8 MB, N16R8-Modul, siehe docs/board-recherche.md).
# Octal-PSRAM ist bei den meisten ESP32-S3-N16R8-Modulen verbaut - falls das
# reale Board Quad-PSRAM hat, muss CONFIG_SPIRAM_MODE_OCT auf
# CONFIG_SPIRAM_MODE_QUAD umgestellt werden (noch nicht am realen Board
# verifiziert, siehe docs/pflichtenheft.txt Abschnitt 12).
CONFIG_SPIRAM=y
CONFIG_SPIRAM_MODE_OCT=y
CONFIG_SPIRAM_SPEED_80M=y

# 16 MB Flash, eigene Partitionstabelle (siehe firmware/partitions.csv und
# docs/entscheidungen.md, Eintrag "Partitionstabelle") - loest das
# Standardpreset "two_ota" (1 MB je Slot) ab, das nach P3 schon bei 75%
# Auslastung eines Slots lag.
CONFIG_ESPTOOLPY_FLASHSIZE_16MB=y
CONFIG_PARTITION_TABLE_CUSTOM=y
CONFIG_PARTITION_TABLE_CUSTOM_FILENAME="partitions.csv"
CONFIG_PARTITION_TABLE_FILENAME="partitions.csv"

# UsbManager (P4, docs/entscheidungen.md) - TinyUSB-Composite-Device CDC+HID
# ueber den nativen USB-Port. Deskriptoren bleiben NULL/Kconfig-generiert.
CONFIG_TINYUSB_CDC_ENABLED=y
CONFIG_TINYUSB_CDC_COUNT=1
CONFIG_TINYUSB_HID_COUNT=1

# WebServerManager (P5) - WebSocket-Konsole braucht das explizit, Default ist aus.
CONFIG_HTTPD_WS_SUPPORT=y

# SshManager (P7) - schaltet WOLFSSH_TERM/WOLFSSL_KEY_GEN/WOLFSSL_PTHREADS
# im mitgelieferten wolfssl/wolfssl user_settings.h-Template frei, ohne
# die ECC/RSA-Weichen dort anzufassen (ESP32-S3 laeuft dort bereits im
# ECC-only-Zweig). Siehe docs/entscheidungen.md "SSH-Server (P7)".
CONFIG_ESP_ENABLE_WOLFSSH=y

# WatchdogManager (RGB-LED, GPIO48) - Task Watchdog Timer ist per
# ESP-IDF-Standard bereits aktiv (5s Timeout, Idle-Tasks beider Kerne
# angemeldet), loest bei einem Timeout aber standardmaessig NUR eine
# Log-Meldung aus, keinen Reboot (CONFIG_ESP_TASK_WDT_PANIC=n per
# Default). Urspruenglich fuer eine echte Selbstheilung bei einer
# haengenden Task explizit auf Panic+Reboot umgestellt - siehe
# docs/entscheidungen.md "Watchdog-LED (RGB, GPIO48)".
#
# HINWEIS (2026-07-23): Die "IDLE0-Starvation" (IDLE0/CPU0 wird ~5,98s nach
# dem Boot nicht mehr eingeplant, Task-Watchdog schlaegt an) ist root-
# ursachlich geklaert UND behoben - es war ein vTaskDelay(0) in
# gpio_manager.c (pdMS_TO_TICKS(5) trunkiert bei 100Hz auf 0 Ticks), NICHT
# der WLAN-Reconnect-Sturm, dem es zunaechst zugeschrieben wurde. Siehe
# docs/entscheidungen.md "WireGuard-Tunnel echt zum Laufen gebracht ...".
# Nach dem Fix lief der Dauerbetrieb (inkl. WireGuard-Tunnel) sauber, daher
# ist Panic+Reboot als echte Selbstheilung wieder aktiv: haengt eine
# ueberwachte Task, rebootet das Geraet automatisch statt nur zu loggen.
# Die RGB-LED (watchdog_manager) blinkt unabhaengig davon als
# Lebenszeichen-Anzeige weiter.
CONFIG_ESP_TASK_WDT_PANIC=y

# OtaManager - Bootloader-Rollback: bleibt eine frisch geflashte OTA-
# Firmware kurz nach dem Start haengen/stuerzt ab (bevor
# esp_ota_mark_app_valid_cancel_rollback() in app_main() erreicht wird),
# rollt der Bootloader beim naechsten Boot automatisch auf die vorherige
# funktionierende Partition zurueck. Per ESP-IDF-Default aus - explizit
# aktiviert, siehe docs/entscheidungen.md "OTA-Update ...".
CONFIG_BOOTLOADER_APP_ROLLBACK_ENABLE=y

# Main-Task-Stack von 3584 (ESP-IDF-Default) auf 16384 angehoben - beim
# ersten echten Hardware-Bring-up (2026-07-23) fand ssh_manager_init()'s
# Host-Key-Erzeugung (generate_and_save_host_key(), wolfSSL SHA256 ueber
# den generierten Schluessel) reproduzierbar einen Stack-Overflow auf dem
# main-Task, direkt nach dem Start von SnmpManager. Diese Erzeugung laeuft
# VOR dem dedizierten 8192-Byte ssh_task (siehe ssh_manager.c Kommentar
# "sm-Stack-Overflow-Lehre") - der war zwar schon grosszuegig bemessen,
# der main-Task selbst aber nicht. Siehe docs/entscheidungen.md.
CONFIG_ESP_MAIN_TASK_STACK_SIZE=16384

# WireGuard (droscy/esp_wireguard) legt sein Netzwerk-Interface per rohem
# lwIP netif_add() an, NICHT ueber esp_netif - netif->state zeigt dort auf
# die wireguardif-Struktur. Ohne diese Option ist LWIP_ESP_NETIF_DATA=0,
# und esp_netif nutzt netif->state, um jedem netif seinen esp_netif-Wrapper
# zuzuordnen. Der globale esp_netif-Callback (esp_netif_internal_dhcpc_cb)
# haelt das rohe WG-netif dann faelschlich fuer ein esp_netif und
# dereferenziert dessen (NULL-)ip_info -> Guru Meditation (LoadProhibited)
# beim Tunnelaufbau. Bridge-Support zu aktivieren schaltet
# LWIP_ESP_NETIF_DATA=1 (siehe components/lwip/port/include/lwipopts.h),
# wodurch esp_netif seinen Zeiger stattdessen in netif->client_data ablegt;
# das rohe WG-netif liefert dort korrekt NULL und wird vom Callback sauber
# uebersprungen. Der Bridge-Code selbst wird nicht genutzt. Siehe
# docs/entscheidungen.md.
CONFIG_ESP_NETIF_BRIDGE_EN=y
```

## firmware/sdkconfig.defaults.esp32-s3-devkitc-1-n8r8
```kconfig
# Nur fuer env:esp32-s3-devkitc-1-n8r8 - siehe Kommentar in platformio.ini.
# Ueberschreibt die in sdkconfig.defaults gesetzte 16-MB-Flashgroesse
# (CONFIG_ESPTOOLPY_FLASHSIZE_16MB) auf 8 MB. ESPTOOLPY_FLASHSIZE_* ist ein
# Kconfig-"choice" (siehe esptool_py/Kconfig.projbuild) - PlatformIOs
# kconfgen versteht das beim Zusammenfuehren mehrerer sdkconfig.defaults*-
# Dateien korrekt, der zuletzt gesetzte Wert gewinnt und schaltet die
# anderen Optionen der Gruppe automatisch aus, kein manuelles "is not set"
# fuer FLASHSIZE_16MB noetig.
CONFIG_ESPTOOLPY_FLASHSIZE_8MB=y
```

## firmware/sdkconfig.defaults.wokwi-sim
```kconfig
# Nur fuer die Wokwi-Simulation (env:wokwi-sim) - siehe Kommentar in
# platformio.ini. Deaktiviert PSRAM komplett, weil Wokwis ESP32-S3-Emulation
# den Octal-PSRAM-Speichertest nicht besteht und die hier simulierte P2-Logik
# (GpioManager) kein PSRAM benoetigt. Das reale Board (env oben) behaelt
# CONFIG_SPIRAM=y ueber sdkconfig.defaults.
CONFIG_SPIRAM=n
```
